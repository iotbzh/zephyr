## boards/arm/rcar_falcon/Kconfig.board
```kconfig
# Copyright (c) 2022 IoT.bzh
# SPDX-License-Identifier: Apache-2.0

config BOARD_RCAR_FALCON_CR52
	bool "Cortex-R52 for Renesas Falcon"
	depends on SOC_R8A779A0
```

## boards/arm/rcar_falcon/Kconfig.defconfig
```kconfig
# Copyright (c) 2022 IoT.bzh
# SPDX-License-Identifier: Apache-2.0

if BOARD_RCAR_FALCON_CR52

config BOARD
	default "rcar_falcon_cr52"

endif # BOARD_RCAR_FALCON_CR52
```

## boards/arm/rcar_s4sk/Kconfig.board
```kconfig
# Copyright (c) 2022 IoT.bzh
# SPDX-License-Identifier: Apache-2.0

config BOARD_RCAR_S4SK_CR52
	bool "Cortex-R52 for Renesas S4SK"
	depends on SOC_R8A779F0
```

## boards/arm/rcar_s4sk/Kconfig.defconfig
```kconfig
# Copyright (c) 2022 IoT.bzh
# SPDX-License-Identifier: Apache-2.0

if BOARD_RCAR_S4SK_CR52

config BOARD
	default "rcar_s4sk_cr52"

endif # BOARD_RCAR_S4SK_CR52
```

## drivers/pwm/Kconfig.rcar
```kconfig
# Reneas R-Car PWM configuration options

# Copyright (c) 2022 IoT.bzh
# SPDX-License-Identifier: Apache-2.0

DT_COMPAT_RENESAS_RCAR_PWM := renesas,rcar-pwm

config PWM_RCAR
	bool "Renesas R-Car PWM Driver"
	default $(dt_compat_enabled,$(DT_COMPAT_RENESAS_RCAR_PWM))
	depends on SOC_FAMILY_RCAR
	help
	  Enable Renesas R-Car PWM Driver.
```

## dts/bindings/can/renesas,rcar-canfd.yaml
```yaml
description: Renesas R-Car CAN-FD controller

compatible: "renesas,rcar-canfd"

include: [can-controller.yaml, pinctrl-device.yaml]

properties:
    reg:
      required: true

    interrupts:
      required: true

    clocks:
      required: true
```

## dts/bindings/clock/renesas,r8a779a0-cpg-mssr.yaml
```yaml
# Copyright (c) 2022, IoT.bzh
# SPDX-License-Identifier: Apache-2.0

description: Renesas R8A779A0 SoC Clock Pulse Generator / Module Standby and Software Reset

compatible: "renesas,r8a779a0-cpg-mssr"

include: renesas,rcar-cpg-mssr.yaml
```

## dts/bindings/clock/renesas,r8a779f0-cpg-mssr.yaml
```yaml
# Copyright (c) 2022, IoT.bzh
# SPDX-License-Identifier: Apache-2.0

description: Renesas R8A779F0 SoC Clock Pulse Generator / Module Standby and Software Reset

compatible: "renesas,r8a779f0-cpg-mssr"

include: renesas,rcar-cpg-mssr.yaml
```

## dts/bindings/display/rcar,rcar-du.yaml
```yaml
#
# Copyright (c) 2020 IoT.bzh
#
# SPDX-License-Identifier: Apache-2.0
#

description: Renesas RCAR DU

compatible: "renesas,rcar-du"

include: [base.yaml]

properties:

    label:
      required: true

    reg:
      required: true
    
    vsps:
      type: phandle
      required: true
```

## dts/bindings/display/rcar,rcar-fcpv.yaml
```yaml
#
# Copyright (c) 2020 IoT.bzh
#
# SPDX-License-Identifier: Apache-2.0
#

description: Renesas RCAR FCP

compatible: "renesas,rcar-fcpv"

include: [base.yaml]

properties:

    label:
      required: true

    reg:
      required: true
```

## dts/bindings/display/rcar,rcar-vsp.yaml
```yaml
#
# Copyright (c) 2020 IoT.bzh
#
# SPDX-License-Identifier: Apache-2.0
#

description: Renesas RCAR VSP

compatible: "renesas,rcar-vsp"

include: [base.yaml]

properties:

    label:
      required: true

    reg:
      required: true

    renesas,fcp:
      type: phandle
      required: true
```

## dts/bindings/pwm/renesas,rcar-pwm.yaml
```yaml
# Copyright (c) 2022, IoT.bzh
# SPDX-License-Identifier: Apache-2.0

description: Renesas R-Car PWM controller

compatible: "renesas,rcar-pwm"

include: [pwm-controller.yaml, pinctrl-device.yaml, base.yaml]

properties:
    "#pwm-cells":
      const: 2

pwm-cells:
  - channel
  - flags
```

## dts/bindings/serial/renesas,rcar-gen3-scif.yaml
```yaml
description: Renesas R-Car Gen3 UART controller

compatible: "renesas,rcar-gen3-scif"

include: uart-controller.yaml

properties:
    reg:
      required: true

    interrupts:
      required: true

    clocks:
      required: true
```

## dts/bindings/serial/renesas,rcar-scif.yaml
```yaml
# Copyright (c) 2021, IoT.bzh
# SPDX-License-Identifier: Apache-2.0
#
description: Renesas R-Car UART controller

compatible: "renesas,rcar-scif"

include: uart-controller.yaml

properties:
    reg:
      required: true

    clocks:
      required: true

    pinctrl-0:
      type: phandles
      required: false
      description: |
        GPIO pin configuration for SCIF RX and TX. The phandles are
        expected to reference pinctrl nodes, e.g.
          pinctrl-0 = <&scif1_data_a_tx &scif1_data_a_rx>;
```

## soc/arm/renesas_rcar/gen4/Kconfig.defconfig.r8a779a0
```kconfig
# Copyright (c) 2022 IoT.bzh
# SPDX-License-Identifier: Apache-2.0

if SOC_R8A779A0

config SOC
	default "r8a779a0"

config NUM_IRQS
	default 991

config PINCTRL
       default y

endif # SOC_R8A779A0
```

## soc/arm/renesas_rcar/gen4/Kconfig.soc
```kconfig
# Copyright (c) 2022 IoT.bzh
# SPDX-License-Identifier: Apache-2.0

choice
	prompt "Renesas RCar SoC Selection"
	depends on SOC_SERIES_RCAR_GEN4

config SOC_R8A779F0
	bool "r8a779f0"

config SOC_R8A779A0
	bool "r8a779a0"

endchoice
```
